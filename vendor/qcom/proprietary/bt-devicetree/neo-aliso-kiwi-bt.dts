/dts-v1/;
/plugin/;

#include "neo-aliso-kiwi-bt.dtsi"

/ {
	model = "Qualcomm Technologies, Inc. ALISO HMT";
	compatible = "qcom,neo-idp", "qcom,neo", "qcom,idp";
	qcom,msm-id = <739 0x10000>, <740 0x10000>;
	qcom,board-id = <0 0>, <33 1>, <34 0>, <34 1>, <34 2>, <34 3>, <44 1>;
};

